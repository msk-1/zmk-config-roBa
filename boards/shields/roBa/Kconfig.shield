## boards/shields/roBa/Kconfig.shield
```kconfig
# roBa シールド定義
# - ビルド時のシールド選択用

config SHIELD_ROBA_R
    def_bool $(shields_list_contains,roBa_R)

config SHIELD_ROBA_L
    def_bool $(shields_list_contains,roBa_L)

# レイアウトシフト機能のターゲットレイアウト選択
choice LAYOUT_SHIFT_TARGET_LAYOUT
    prompt "Target keyboard layout"
    default LAYOUT_SHIFT_TARGET_JIS

config LAYOUT_SHIFT_TARGET_JIS
    bool "Japanese (JIS)"

config LAYOUT_SHIFT_TARGET_DVORAK
    bool "Dvorak"

config LAYOUT_SHIFT_TARGET_COLEMAK
    bool "Colemak"

endchoice
```

## config/west.yml
```yaml
# roBa 依存モジュール設定
# - zmk: ZMKファームウェア本体
# - zmk-pmw3610-driver: トラックボールドライバー
# - zmk-input-processor-temp-layer-threshold: オートマウスレイヤー（閾値対応）

manifest:
  remotes:
    - name: zmkfirmware
      url-base: https://github.com/zmkfirmware
    - name: kumamuk-git
      url-base: https://github.com/kumamuk-git
    - name: yamaryu211
      url-base: https://github.com/yamaryu211
    - name: kot149
      url-base: https://github.com/kot149
  projects:
    - name: zmk
      remote: zmkfirmware
      revision: v0.3-branch
      import: app/west.yml
    - name: zmk-pmw3610-driver
      remote: kumamuk-git
      revision: main
    - name: zmk-input-processor-temp-layer-threshold
      remote: yamaryu211
      revision: main
    - name: zmk-layout-shift
      remote: kot149
      revision: v1
  self:
    path: config
```
